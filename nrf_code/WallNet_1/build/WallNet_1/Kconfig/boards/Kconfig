## nrf_code/WallNet_1/build/WallNet_1/Kconfig/boards/Kconfig
```kconfig
# Load Zephyr board Kconfig descriptions.
osource "C:/ncs/v3.2.3/zephyr/boards/nordic/nrf52dk/Kconfig"
```

## nrf_code/WallNet_1/build_1/Kconfig/boards/Kconfig.defconfig
```kconfig
# Load Zephyr board defconfig descriptions.
osource "C:/ncs/v3.2.2/zephyr/boards/nordic/nrf52dk/Kconfig.defconfig"
```

## nrf_code/WallNet_1/build_1/Kconfig/boards/Kconfig.sysbuild
```kconfig
# Load Sysbuild board Kconfig descriptions.
osource "C:/ncs/v3.2.2/zephyr/boards/nordic/nrf52dk/Kconfig.sysbuild"
```
